## main/Kconfig.projbuild
```kconfig
menu "ESP-SWD DAPLink 配置"

    menu "1. SWD 引脚与调试口"

        config PROBE_SWCLK_GPIO
            int "SWCLK 引脚 (GPIO 编号)"
            default 4
            range 0 31
            help
                SWD 时钟线，接到目标板 SWCLK。

        config PROBE_SWDIO_GPIO
            int "SWDIO 引脚 (GPIO 编号)"
            default 5
            range 0 31
            help
                SWD 数据线，接到目标板 SWDIO。

        config PROBE_NRESET_GPIO
            int "nRESET 引脚 (-1 表示不接)"
            default 6
            help
                可选。接到目标板 NRST，用于硬件复位与 DAP_ResetTarget。

        config PROBE_DEFAULT_CLOCK_KHZ
            int "SWD 默认时钟 (kHz)"
            default 1000
            range 100 50000
            help
                上电后的默认 SWD 请求频率，上位机可通过 DAP_SWJ_Clock 修改。
                GPIO 位操作的实际频率受执行开销限制，不能等同于请求频率。

    endmenu

    menu "2. 目标串口 (虚拟串口转发)"

        config TARGET_UART_PORT
            int "UART 端口号 (0/1/2)"
            default 1
            range 0 2

        config TARGET_UART_TX_GPIO
            int "UART TX 引脚"
            default 17

        config TARGET_UART_RX_GPIO
            int "UART RX 引脚"
            default 18

        config TARGET_UART_BAUD
            int "UART 默认波特率"
            default 115200

    endmenu

    menu "3. USB 设备"

        config USB_DEVICE_VID
            hex "USB VID"
            default 0x0D28

        config USB_DEVICE_PID
            hex "USB PID"
            default 0x0204

        config USB_DEVICE_MANUFACTURER
            string "USB 厂商字符串"
            default "ESP-SWD"

        config USB_DEVICE_PRODUCT
            string "USB 产品字符串"
            default "ESP32-S3 CMSIS-DAP"

    endmenu

    menu "4. WiFi 链路"

        config LINK_WIFI_SSID
            string "WiFi SSID (留空则只开热点)"
            default ""

        config LINK_WIFI_PASSWORD
            string "WiFi 密码"
            default ""

        config LINK_AP_SSID
            string "热点 SSID (STA 失败或未配置时启用)"
            default "ESP-SWD"

        config LINK_AP_PASSWORD
            string "热点密码 (至少 8 位)"
            default ""

        config LINK_TCP_PORT
            int "DAP 服务 TCP 端口 (pyOCD remote 协议)"
            default 5555

        config LINK_SERIAL_TCP_PORT
            int "串口桥 TCP 端口"
            default 5556

        config LINK_OTA_TCP_PORT
            int "ESP32 OTA TCP port"
            range 1 65535
            default 5557

        config OTA_IDLE_TIMEOUT_SECONDS
            int "OTA receive idle timeout (seconds)"
            range 30 600
            default 120

        config OTA_READY_TIMEOUT_SECONDS
            int "OTA verified image activation timeout (seconds)"
            range 60 3600
            default 600

    endmenu

    menu "5. 蓝牙链路"

        config LINK_BLE_ENABLE
            bool "启用 BLE DAP/串口桥"
            default y

        config LINK_BLE_NAME
            string "BLE 设备名"
            default "ESP-SWD"

        config BLE_OTA_BUTTON_GPIO
            int "BLE OTA 授权按钮 GPIO（低有效，长按 2 秒；-1 禁用）"
            range -1 48
            default 0
            help
                默认开发板 BOOT 按钮。只在程序运行时长按，不要同时复位。
                也可用控制台 ota arm 开放 5 分钟升级窗口。

        config BLE_OTA_REQUIRE_ENCRYPTION
            bool "Require an encrypted BLE connection for OTA writes"
            default y
            help
                Pair/encrypt the BLE connection before uploading firmware.
                Just Works encryption is not image signing or MITM protection.

    endmenu

    menu "6. 本地面板与 microSD"

        config FRONT_PANEL_ENABLED
            bool "启用 ST7789、六键和 1-bit SDMMC"
            default y
            help
                使用本板固定引脚表。若自定义 SWD/UART/OTA 引脚与面板共用，
                固件会跳过面板初始化。

        if FRONT_PANEL_ENABLED
            config FRONT_LCD_CLOCK_MHZ
                int "ST7789 SPI3 时钟 (MHz)"
                range 1 40
                default 20

            config FRONT_LCD_INVERT
                bool "ST7789 显示反色模式"
                default y

            config FRONT_LCD_BL_ACTIVE_LOW
                bool "LCD 背光控制低有效"
                default n
        endif

    endmenu

endmenu
```

## sdkconfig.defaults
```kconfig
# ============================================================
#  ESP32-S3 多链路 DAPLink —— 默认配置
# ============================================================
CONFIG_IDF_TARGET="esp32s3"

# ---------- 系统 ----------
CONFIG_ESP_DEFAULT_CPU_FREQ_MHZ_240=y
CONFIG_ESP_MAIN_TASK_STACK_SIZE=8192
CONFIG_ESP_SYSTEM_EVENT_TASK_STACK_SIZE=3072
CONFIG_FREERTOS_HZ=1000
CONFIG_COMPILER_OPTIMIZATION_PERF=y
CONFIG_ESP_TASK_WDT_TIMEOUT_S=20

# 本机 ESP32-S3 N16R8 的 8 MB Octal PSRAM，给 BLE/OTA 留出内部 RAM。
CONFIG_SPIRAM=y
CONFIG_SPIRAM_MODE_OCT=y
CONFIG_SPIRAM_SPEED_80M=y
CONFIG_SPIRAM_USE_MALLOC=y
CONFIG_SPIRAM_MALLOC_ALWAYSINTERNAL=4096
CONFIG_SPIRAM_MALLOC_RESERVE_INTERNAL=32768
CONFIG_BT_NIMBLE_MEM_ALLOC_MODE_EXTERNAL=y

# ---------- Flash / 分区 ----------
CONFIG_ESPTOOLPY_FLASHSIZE_16MB=y
CONFIG_PARTITION_TABLE_CUSTOM=y
CONFIG_PARTITION_TABLE_CUSTOM_FILENAME="partitions.csv"
CONFIG_BOOTLOADER_APP_ROLLBACK_ENABLE=y
CONFIG_ESPTOOLPY_FLASHMODE_QIO=y

# ---------- 日志 ----------
CONFIG_LOG_DEFAULT_LEVEL_INFO=y
CONFIG_LOG_MAXIMUM_LEVEL_INFO=y
CONFIG_ESP_CONSOLE_UART_DEFAULT=y
CONFIG_ESP_CONSOLE_UART_BAUDRATE=115200

# ---------- 板级 GPIO ----------
CONFIG_PROBE_SWCLK_GPIO=4
CONFIG_PROBE_SWDIO_GPIO=5
CONFIG_PROBE_NRESET_GPIO=6
CONFIG_PROBE_DEFAULT_CLOCK_KHZ=1000

# ---------- 目标 UART ----------
CONFIG_TARGET_UART_PORT=1
CONFIG_TARGET_UART_TX_GPIO=17
CONFIG_TARGET_UART_RX_GPIO=18
CONFIG_TARGET_UART_BAUD=115200

# ---------- USB (TinyUSB) ----------
CONFIG_TINYUSB_CDC_ENABLED=y
CONFIG_TINYUSB_CDC_COUNT=1
CONFIG_TINYUSB_HID_COUNT=1
CONFIG_TINYUSB_CDC_RX_BUFSIZE=1024
CONFIG_TINYUSB_CDC_TX_BUFSIZE=4096
CONFIG_TINYUSB_CDC_EP_BUFSIZE=512

# ---------- WiFi ----------
CONFIG_ESP_WIFI_STATIC_RX_BUFFER_NUM=8
CONFIG_ESP_WIFI_DYNAMIC_RX_BUFFER_NUM=16
CONFIG_ESP_WIFI_DYNAMIC_TX_BUFFER_NUM=16
CONFIG_ESP_WIFI_AMPDU_RX_ENABLED=y
CONFIG_ESP_WIFI_AMPDU_TX_ENABLED=y
CONFIG_ESP_WIFI_NVS_ENABLED=y
CONFIG_ESP_WIFI_SOFTAP_SUPPORT=y
CONFIG_LWIP_MAX_SOCKETS=16
CONFIG_LWIP_TCP_SND_BUF_DEFAULT=8192
CONFIG_LWIP_TCP_WND_DEFAULT=8192
CONFIG_LWIP_TCP_RECVMBOX_SIZE=16

# ---------- 蓝牙 (NimBLE) ----------
CONFIG_BT_ENABLED=y
CONFIG_BT_NIMBLE_ENABLED=y
CONFIG_BT_NIMBLE_ROLE_PERIPHERAL=y
CONFIG_BT_NIMBLE_ROLE_CENTRAL=n
CONFIG_BT_NIMBLE_ROLE_BROADCASTER=y
CONFIG_BT_NIMBLE_ROLE_OBSERVER=n
CONFIG_BT_NIMBLE_MAX_CONNECTIONS=1
CONFIG_BT_NIMBLE_ATT_PREFERRED_MTU=512
CONFIG_BT_NIMBLE_MAX_BONDS=3
CONFIG_BT_NIMBLE_SM_SC=y
CONFIG_BT_NIMBLE_HS_STOP_TIMEOUT_MS=2000

# ---------- 共存 ----------
CONFIG_ESP_COEX_SW_COEXIST_ENABLE=y
CONFIG_BT_CTRL_COEX_PHY_CODED_TX_RX_TLIM_EN=y
```
